## app/boards/shields/khapanh_k0rn3/Kconfig.defconfig
```kconfig
if SHIELD_KHAPANH_K0RN3_LEFT

config ZMK_KEYBOARD_NAME
    default "Yuhnim C0rn3"

config ZMK_SPLIT_BLE_ROLE_CENTRAL
    default y

endif

if SHIELD_KHAPANH_K0RN3_LEFT || SHIELD_KHAPANH_K0RN3_RIGHT

config ZMK_SPLIT
    default y

endif
```

## app/boards/shields/khapanh_k0rn3/Kconfig.shield
```kconfig
config SHIELD_KHAPANH_K0RN3_LEFT
    def_bool $(shields_list_contains,khapanh_k0rn3_left)
    
config SHIELD_KHAPANH_K0RN3_RIGHT
    def_bool $(shields_list_contains,khapanh_k0rn3_right)
```
